## CMakeLists.txt
```
cmake_minimum_required(VERSION 3.20.0)
find_package(Zephyr REQUIRED HINTS $ENV{ZEPHYR_BASE})

project(nrf53_update)

target_sources(app PRIVATE src/main.c)
```

## sysbuild.conf
```
# Step 1.1 - Enable MCUboot 
SB_CONFIG_BOOTLOADER_MCUBOOT=y

# Add something to the netcore
#SB_CONFIG_NETCORE_HCI_IPC=y

#SB_CONFIG_NETCORE_RADIO_TEST=y

# Add netcore bootloader
SB_CONFIG_SECURE_BOOT_NETCORE=y
SB_CONFIG_NETCORE_APP_UPDATE=y

# STEP 6.3 - Configure project to use external flash for DFU
# SB_CONFIG_PM_EXTERNAL_FLASH_MCUBOOT_SECONDARY=y

SB_CONFIG_MCUBOOT_UPDATEABLE_IMAGES=2
# SB_CONFIG_MCUBOOT_NRF53_MULTI_IMAGE_UPDATE=y
# SB_CONFIG_MCUBOOT_MODE_OVERWRITE_ONLY=y
SB_CONFIG_MCUBOOT_MODE_OVERWRITE_ONLY=y
SB_CONFIG_MCUBOOT_APP_SYNC_UPDATEABLE_IMAGES=n
```

## prj.conf
```kconfig
CONFIG_GPIO=y

CONFIG_LOG=y
CONFIG_SHELL=y
CONFIG_SHELL_BACKEND_SERIAL=y

CONFIG_FLASH=y
CONFIG_FLASH_MAP=y
CONFIG_MCUBOOT_IMG_MANAGER=y
CONFIG_STREAM_FLASH=y
CONFIG_IMG_MANAGER=y
CONFIG_MCUBOOT_SHELL=y

CONFIG_MCUBOOT_EXTRA_IMGTOOL_ARGS="--confirm"
```

## src/main.c
```c
/*
* Copyright (c) 2016 Intel Corporation
*
* SPDX-License-Identifier: Apache-2.0
*/

#include <zephyr/kernel.h>
#include <zephyr/drivers/gpio.h>

#define SLEEP_TIME_MS   500

/* STEP 4.4 - Change LED timing to create a new image for DFU*/
//  #define SLEEP_TIME_MS   2000

/* The devicetree node identifier for the "led0" alias. */
#define LED0_NODE DT_ALIAS(led0)

/*
* A build error on this line means your board is unsupported.
* See the sample documentation for information on how to fix this.
*/
static const struct gpio_dt_spec led = GPIO_DT_SPEC_GET(LED0_NODE, gpios);

int main(void)
{
        int ret;

        if (!device_is_ready(led.port)) {
                return -1;
        }

        ret = gpio_pin_configure_dt(&led, GPIO_OUTPUT_ACTIVE);
        if (ret < 0) {
                return -1;
        }

        while (1) {
                ret = gpio_pin_toggle_dt(&led);
                if (ret < 0) {
                        return -1;
                }
                k_msleep(SLEEP_TIME_MS);
        }
}
```
